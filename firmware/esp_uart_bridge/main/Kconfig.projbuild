## firmware/esp_uart_bridge/main/Kconfig.projbuild
```kconfig
menu "Dreame bridge configuration"

config BRIDGE_WIFI_SSID
    string "Default Wi-Fi SSID (used until one is set from the app)"
    default "changeme"
    help
        Build-time fallback only. The network is normally set at runtime with
        the app / "wifi.set" command and stored in NVS, which takes priority.
        Leave "changeme" to boot straight into the setup access point.

config BRIDGE_WIFI_PASSWORD
    string "Default Wi-Fi password"
    default "changeme"
    help
        WPA2/WPA3 passphrase for BRIDGE_WIFI_SSID (8..63 characters).
        Open networks are refused.

config BRIDGE_SETUP_AP_PASSWORD
    string "Setup access point password"
    default "dreame-setup"
    help
        WPA2 passphrase of the "DreameBridge-XXXX" setup AP (8..63 chars).
        Anyone who knows it can reach the robot's UART/SWD while the setup
        AP is up, so change it for your build.

config BRIDGE_SETUP_AP_DELAY_S
    int "Seconds without a network before the setup AP comes up"
    default 30
    range 5 3600
    help
        The setup AP also comes up immediately when no network is configured,
        and on request (app, "wifi.ap on", setup button).

config BRIDGE_SETUP_BUTTON_GPIO
    int "Setup button GPIO (hold 3 s for the setup AP), -1 to disable"
    default 0
    help
        GPIO0 is the BOOT button on the LOLIN S2 mini.

config BRIDGE_HOSTNAME
    string "DHCP hostname"
    default "dreame-bridge"

config BRIDGE_DISCOVERY_ENABLE
    bool "Enable LAN discovery"
    default y
    help
        Listen for a short UDP discovery request so RobotMonitor can find the
        bridge without a fixed IP. This does not expose Wi-Fi credentials.

config BRIDGE_DISCOVERY_PORT
    int "LAN discovery UDP port"
    default 2326
    help
        UDP port used by the RobotMonitor discovery request and response.

config BRIDGE_TCP_PORT
    int "TCP port for the MCU UART"
    default 2324

config BRIDGE_UART_TX_GPIO
    int "GPIO that drives the MCU UART RX line (ESP TX)"
    default 35
    help
        LOLIN S2 mini: GPIO35 (ESP32-S3 defaults are in
        sdkconfig.defaults.esp32s3). Put 1 kohm in series once the robot pin
        is verified.

config BRIDGE_UART_RX_GPIO
    int "GPIO that listens to the MCU UART TX line (ESP RX)"
    default 33
    help
        LOLIN S2 mini: GPIO33.

config BRIDGE_UART_BAUD
    int "Default MCU UART baud rate"
    default 115200
    help
        Used until a rate is set at runtime ("uart.baud <rate>"), which is
        saved in NVS and takes priority.

config BRIDGE_UART_AUTOBAUD
    bool "Probe several baud rates on the MCU UART at boot"
    default n
    help
        Runs 115200/57600/9600 in turn, sends a line feed and "info -a"
        at each, and locks onto the first rate that produces bytes. Adds about
        six seconds to boot.

        Only enable this while bringing up a new wiring harness. It transmits
        garbage into the peer at every rate that does not match, and the peer's
        prompt is never a place to send bytes you have not reasoned about.

config BRIDGE_UART_EVEN_PARITY
    bool "Primary UART even parity"
    default n
    help
        The MCU application UART is 8N1; only enable this for a peer that
        is known to use even parity.

config BRIDGE_UART_RX_BUF
    int "UART driver RX ring buffer (bytes)"
    default 8192
    help
        The bridge drains this ring continuously (with or without a client),
        so it only needs to absorb bursts while Wi-Fi is momentarily slower
        than the UART.

config BRIDGE_UART_SW_FLOWCTRL
    bool "Software flow control (ixoff) toward the robot"
    default n
    help
        When the hardware UART RX FIFO reaches 96 bytes, the bridge sends an
        XOFF byte (0x13) on its TX line and an XON byte (0x11) after it drains
        below 32 bytes. This can prevent loss if the robot floods the console
        while Wi-Fi is slower than 115200 baud, but enable it only after
        confirming that the robot honours XON/XOFF. It is disabled by default
        because an unsupported peer could treat these bytes as console input.

config BRIDGE_SOC_UART_ENABLE
    bool "Enable the SoC shell UART (second channel)"
    default y
    help
        Second UART channel for the robot SoC's Linux shell, on UART0 (free
        because the ESP console is on native USB). Exposed on its own TCP
        port, in the web app terminal and through the soc.* commands.

config BRIDGE_SOC_UART_NUM
    int "UART peripheral for the SoC shell"
    depends on BRIDGE_SOC_UART_ENABLE
    range 0 2
    default 0
    help
        0 on the ESP32-S2 (UART1 carries the MCU channel). The ESP32-S3 uses
        UART2 so UART0 stays available as a console.

config BRIDGE_SOC_TCP_PORT
    int "TCP port for the SoC shell UART"
    depends on BRIDGE_SOC_UART_ENABLE
    default 2323

config BRIDGE_SOC_UART_TX_GPIO
    int "GPIO that drives the SoC UART RX line (ESP TX)"
    depends on BRIDGE_SOC_UART_ENABLE
    default 37
    help
        LOLIN S2 mini: GPIO37. Put 1 kohm in series once the robot pin is
        verified.

config BRIDGE_SOC_UART_RX_GPIO
    int "GPIO that listens to the SoC UART TX line (ESP RX)"
    depends on BRIDGE_SOC_UART_ENABLE
    default 39
    help
        LOLIN S2 mini: GPIO39.

config BRIDGE_SOC_UART_BAUD
    int "Default SoC UART baud rate"
    depends on BRIDGE_SOC_UART_ENABLE
    default 115200
    help
        Used until a rate is set at runtime ("soc.baud <rate>").

config BRIDGE_SOC_UART_EVEN_PARITY
    bool "SoC UART even parity"
    depends on BRIDGE_SOC_UART_ENABLE
    default n

config BRIDGE_SOC_UART_RX_BUF
    int "SoC UART driver RX ring buffer (bytes)"
    depends on BRIDGE_SOC_UART_ENABLE
    default 8192

config BRIDGE_LED_GPIO
    int "Status LED GPIO, -1 to disable"
    default 15
    help
        LOLIN S2 mini: GPIO15, active high. ESP32-S3-DevKitC-1 has an
        addressable RGB LED instead, so set this to -1 there.

config BRIDGE_FLUSH_ON_CONNECT
    bool "Discard buffered UART data when a client connects"
    default y
    help
        Prevents a new client from being greeted with minutes-old, truncated
        log fragments. Turn off if you want to catch a boot log without being
        connected first.

config BRIDGE_UART_BACKLOG
    int "Bytes received before connect that are replayed to a new client"
    depends on !BRIDGE_FLUSH_ON_CONNECT
    default 4096
    range 0 32768
    help
        While no client is connected the bridge keeps the newest N bytes of
        UART data (per channel) and sends them first when a client connects,
        so a boot log or a reply that raced the connection is not lost.
        0 disables the backlog (pre-connect data is then only counted).

config BRIDGE_MDNS_ENABLE
    bool "Advertise the bridge over mDNS (<hostname>.local)"
    default y
    help
        Lets tools reach the bridge as dreame-bridge.local instead of a DHCP
        address that changes. Also advertises _dreame-bridge._tcp for the
        MCU UART port. Requires the espressif/mdns managed component
        (fetched automatically on the first build).

config BRIDGE_SWD_ENABLE
    bool "Enable SWD bridge"
    default y
    help
        Expose SWD diagnostics, core control, and memory operations over TCP.
        The text API includes SRAM and Flash writes. GPIO16/GPIO18 are reserved
        for SWDIO/SWCLK in the S2 mini wiring.

config BRIDGE_SWD_TCP_PORT
    int "SWD text TCP port"
    help
        The text endpoint supports memory reads, core debug controls, SRAM
        writes, and Flash writes. Keep the bridge on a trusted LAN.
    default 2325

config BRIDGE_SWD_REMOTE_BITBANG_TCP_PORT
    int "OpenOCD remote-bitbang TCP port"
    default 3335

config BRIDGE_SWDIO_GPIO
    int "SWDIO GPIO"
    default 16

config BRIDGE_SWCLK_GPIO
    int "SWCLK GPIO"
    default 18

config BRIDGE_SWD_CLOCK_KHZ
    int "SWD clock (kHz)"
    default 1000
    help
        The software SWD engine uses a CPU-cycle delay to approximate this
        clock. GPIO and protocol overhead affect the actual rate. The
        remote-bitbang/OpenOCD path is a separate transport.

config BRIDGE_SWD_MAX_READ
    int "Maximum bytes per SWD read request"
    default 4096

endmenu
```
